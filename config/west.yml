## config/west.yml
```yaml
manifest:
  remotes:
    - name: zmkfirmware
      url-base: https://github.com/urob/   # <--- CHANGE REPO
  projects:
    - name: zmk
      remote: zmkfirmware
      revision: mouse-3.2               # <--- CHANGE REVISION
      import: app/west.yml
  self:
    path: config
```
